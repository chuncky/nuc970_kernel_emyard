## drivers/net/wireless/AiLDK/Kconfig
```kconfig
config AiLDK
	tristate "AiLDK FullMAC wireless cards support"
	depends on MMC
	---help---
	  This module adds support for wireless adapters based on
	  AiLDK FullMAC chipset.

config AiLDK_FW_PATH
	depends on AiLDK
	string "Firmware path"
	default "/system/etc/firmware/fw_AiLDK.bin"
	---help---
	  Path to the firmware file.

config AiLDK_NVRAM_PATH
	depends on AiLDK
	string "NVRAM path"
	default "/system/etc/firmware/nvram.txt"
	---help---
	  Path to the calibration file.

config AiLDK_WEXT
	bool "Enable WEXT support"
	depends on AiLDK && CFG80211 = n
	select WIRELESS_EXT
	select WEXT_PRIV
	help
	  Enables WEXT support

choice
	prompt "Enable Chip Interface"
	depends on AiLDK
	---help---
		Enable Chip Interface.
config AiLDK_SDIO
		bool "SDIO bus interface support"
		depends on AiLDK && MMC
config AiLDK_PCIE
		bool "PCIe bus interface support"
		depends on AiLDK && PCI
endchoice

choice
	depends on AiLDK && AiLDK_SDIO
	prompt "Interrupt type"
	---help---
		Interrupt type
config AiLDK_OOB
	depends on AiLDK && AiLDK_SDIO
	bool "Out-of-Band Interrupt"
	default y
	---help---
		Interrupt from WL_HOST_WAKE.
config AiLDK_SDIO_IRQ
	depends on AiLDK && AiLDK_SDIO
	bool "In-Band Interrupt"
	---help---
	  Interrupt from SDIO DAT[1]
endchoice
```
